/*
 * LED_MX.c
 *
 *  Created on: 2024年9月30日
 *      Author: 33088
 */

#include "LED_MX.h"

const uint8_t font_data_CH[]={
    0x00,0x00,0x07,0x7E,0x75,0x04,0x55,0x04,    0x55,0x74,0x55,0x54,0x56,0x54,0x55,0x54,
	0x55,0x54,0x55,0x54,0x75,0x74,0x55,0x54,    0x06,0x04,0x04,0x04,0x04,0x14,0x04,0x08,
	0x00,0x00,0x3E,0xFF,0x22,0x04,0x24,0x04,    0x24,0xF4,0x28,0x94,0x24,0x94,0x24,0x94,
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	0x4A,0x20,0x48,0x20,0x4F,0xFF,0x78,0x20,    0x48,0x50,0x00,0x88,0x01,0x04,0x06,0x03,

};

const uint8_t font_data_EN[] = {
	0x00,0x00,0x00,0x00,0x00,0x00,0x00,0x00,    0x00,0x00,0x00,0x00,0x00,0x00,0x00,0x00,
	0x00,0x00,0x00,0x10,0x10,0x10,0x10,0x10,    0x10,0x10,0x00,0x00,0x10,0x10,0x00,0x00,
	0x00,0x12,0x24,0x24,0x48,0x00,0x00,0x00,    0x00,0x00,0x00,0x00,0x00,0x00,0x00,0x00,
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	0xB5,0xCA,0xB9,0xD3,0xC3,0xA1,0xA3,
};




uint8_t Show_Buff[SHOW_ROW_NUM][SHOW_COL_NUM];
uint8_t Font_Buff[BUFF_ROW_NUM][BUFF_COL_NUM];
uint8_t str_long = 0;


void LED_MX_init(void)
{
    GPIO_InitTypeDef GPIO_InitStruct;

    /* 使能 GPIO_LED Clock */
    __HAL_RCC_GPIOA_CLK_ENABLE();
    __HAL_RCC_GPIOC_CLK_ENABLE();

    /* 配置 GPIO_LED pin */
    GPIO_InitStruct.Mode = GPIO_MODE_OUTPUT_PP;
    GPIO_InitStruct.Speed = GPIO_SPEED_FREQ_HIGH;
    GPIO_InitStruct.Pin = GPIO_PIN_0 | GPIO_PIN_1 | GPIO_PIN_2 | GPIO_PIN_3 | GPIO_PIN_4 | GPIO_PIN_5 | GPIO_PIN_6 | GPIO_PIN_7;
    HAL_GPIO_Init(GPIOA, &GPIO_InitStruct);
    GPIO_InitStruct.Pin = GPIO_PIN_13;
    HAL_GPIO_Init(GPIOC, &GPIO_InitStruct);

    SET(CLK, 0);
    SET(LE, 0);
    SET(OE, 0); // enable
}

/**时序
 *
 * 行驱动信号，4位地址addr[4]
 * 列驱动信号，SDI,CLK
 *            LE 锁存
 *            OE 使能
 * 时序
 * CLK,SDI输入数据
 * 失能，不显示
 * 锁存数据，切换addr
 * 使能，显示
 *
 */

uint8_t LED_MX_Buff[] = {
    0x00,0x00,0x07,0x7E,0x75,0x04,0x55,0x04,    0x55,0x74,0x55,0x54,0x56,0x54,0x55,0x54,
    0x55,0x54,0x55,0x54,0x75,0x74,0x55,0x54,    0x06,0x04,0x04,0x04,0x04,0x14,0x04,0x08};

void LED_MX_Send_ROW_addr(uint8_t addr)
{
       uint8_t mask = 0x01, data;
       for (uint8_t i = 0; i < 4; i++)
       {
           if (((mask << i) & addr) == 0)
               data = 0;
           else
               data = 1;
           switch (i)
           {
           case 0:
               SET(A0, data);
               break;
           case 1:
               SET(A1, data);
               break;
           case 2:
               SET(A2, data);
               break;
           case 3:
               SET(A3, data);
               break;

           default:
               break;
           }
       }
}
void LED_MX_Send_COL_data(uint8_t data)
{
       uint8_t mask = 0x01;
       SET(CLK, 0);
       for (uint8_t i = 0; i < 8; i++)
       {
           if (((mask << i) & data) == 0)
               SET(SDI, 0);
           else
               SET(SDI, 1);
        //    HAL_Delay(1);
           SET(CLK, 1);
        //    HAL_Delay(1);
           SET(CLK, 0);
        //    HAL_Delay(1);
       }
}

// 锁存
void LED_MX_Latch(void)
{
       SET(LE, 1);
       HAL_Delay(1);
       SET(LE, 0);
}
/* 时序
 * CLK,SDI输入数据
 * 失能，不显示
 * 锁存数据，切换addr
 * 使能，显示
 *
 */

void LED_MX_Scan(uint8_t mode)
{
    // 行扫描
        static uint8_t i = 0;
        if (i == 16)
            i = 0;
        for (uint8_t j = 0; j < SHOW_COL_NUM; j++)
        { 
            // LED_MX_Send_COL_data(LED_MX_Buff[i * SHOW_COL_NUM + SHOW_COL_NUM - 1 - j]);
            if (mode == SHOW_BUFF_MODE)
                LED_MX_Send_COL_data(Show_Buff[i][SHOW_COL_NUM - 1 - j]);
            if (mode == FONT_BUFF_MODE)
                LED_MX_Send_COL_data(Font_Buff[i][SHOW_COL_NUM - 1 - j]);
        }
            
        LED_MX_Show_Disable();
        LED_MX_Latch(); // 锁存
        LED_MX_Send_ROW_addr(i);
        LED_MX_Show_Enable();

        i++;
}   

/*字节合并与位置交换 v*/
uint8_t Combine(uint8_t L, uint8_t H, uint8_t w /*偏移*/)
{
    uint8_t dat;
    if (w < 16)
        dat = (H >> (8 - w)) | (L << w);
    // else
    //     printf("erro \n");
    return dat;
}

/*获取偏移*/
uint8_t get_font_addr(uint8_t *str, uint32_t *offset_out)
{
    uint8_t GBKH, GBKL;
    GBKH = *str;
    GBKL = *(str + 1);
    if (GBKH == 0)
        return (uint8_t)3; // 字符串结束
    else if (0x20 <= GBKH && GBKH <= 0x7E)
    {
        *offset_out = ((uint32_t)GBKH - 0x20) * 16;
        return (uint8_t)1; // English
    }
    else if (0xA1 <= GBKH && GBKH <= 0xFE)
    {
        GBKH -= 0xB0;
        GBKL -= 0xA1;
        *offset_out = ((uint32_t)94 * GBKH + GBKL) * 32;
        return (uint8_t)2; // Chinese
    }

    else
        return (uint8_t)0; // error
}

/*将字符点阵加载到font buff*/
void LED_MX_load_font_buff(uint8_t *STR)
{
    uint32_t offset;
    uint8_t language;
    if (strlen((char*)STR) < BUFF_COL_NUM)
        str_long = strlen((char*)STR);
    else
        str_long = BUFF_COL_NUM;
    for (uint8_t i = 0; i < str_long;)
    {
        language = get_font_addr(STR + i, &offset);

        if (language == 3)
            break;
        if (language == 2) // 写入中文
        {
            for (uint8_t j = 0; j < 16; j++)
            {
                Font_Buff[j][i] = font_data_CH[offset + j * 2];
                Font_Buff[j][i + 1] = font_data_CH[offset + j * 2 + 1];
            }
            i += 2;
        }
        else if (language == 1) // 写入英文
        {
            for (uint8_t j = 0; j < 16; j++)
            {
                Font_Buff[j][i] = font_data_EN[offset + j];
            }
            i += 1;
        }
    }
}

/*将string buff偏移后加载到show buff*/
void LED_MX_load_show_buff(uint16_t w /*偏移*/)
{
    uint8_t w_ch /*字偏移*/, w_bit /*位偏移*/, start = 0, end = SHOW_COL_NUM;
    w = w % ((str_long + SHOW_COL_NUM) * 8);
    w_ch = w / 8;
    w_bit = w % 8;

    if (w_ch <= SHOW_COL_NUM)
        start = SHOW_COL_NUM - w_ch;
    if (w_ch > str_long)
        end = SHOW_COL_NUM + str_long - w_ch;

    // printf("W:%u,w_ch:%u,w_bit:%u,str_long:%u,end:%u,start:%u\n", w, w_ch, w_bit, str_long, end, start);

    for (uint8_t j = 0; j < SHOW_COL_NUM; j++)
    {
        for (uint8_t i = 0; i < SHOW_ROW_NUM; i++)
        {
            if (start == j + 1)
                Show_Buff[i][j] = Combine(0x00, Font_Buff[i][w_ch - SHOW_COL_NUM + j + 1], w_bit);
            if (start < j + 1 && j < end)
                Show_Buff[i][j] = Combine(Font_Buff[i][w_ch - SHOW_COL_NUM + j], Font_Buff[i][w_ch - SHOW_COL_NUM + j + 1], w_bit);
            if (j == end)
                Show_Buff[i][j] = Combine(Font_Buff[i][w_ch - SHOW_COL_NUM + j], 0X00, w_bit);
            if (j + 1 < start || j > end)
                Show_Buff[i][j] = 0X00;
        }
    }
}

